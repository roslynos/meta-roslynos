## build/conf/local.conf
```bitbake
# Machine Selection
MACHINE ?= "raspberrypi3-64"

# The distribution setting controls which policy settings are used as defaults.
DISTRO ?= "roslynos"

# Package Management configuration
PACKAGE_CLASSES ?= "package_rpm"

# The EXTRA_IMAGE_FEATURES variable allows extra packages to be added to the generated images.
EXTRA_IMAGE_FEATURES ?= "debug-tweaks"

# Additional image features
USER_CLASSES ?= "buildstats"

# Interactive shell configuration
PATCHRESOLVE = "noop"

# Disk Space Monitoring during the build
BB_DISKMON_DIRS ??= "\
    STOPTASKS,${TMPDIR},1G,100K \
    STOPTASKS,${DL_DIR},1G,100K \
    STOPTASKS,${SSTATE_DIR},1G,100K \
    STOPTASKS,/tmp,100M,100K \
    HALT,${TMPDIR},100M,1K \
    HALT,${DL_DIR},100M,1K \
    HALT,${SSTATE_DIR},100M,1K \
    HALT,/tmp,10M,1K"

# configuration version
CONF_VERSION = "2"
```

## conf/distro/roslynos.conf
```bitbake
require conf/distro/poky.conf

DISTRO = "roslynos"
DISTRO_NAME = "RoslynOS-Linux"
DISTRO_VERSION = "1.0"
DISTRO_CODENAME = "Dylan"
SDK_VENDOR = "-roslynossdk"
SDK_VERSION="${DISTRO_VERSION}"
TARGET_VENDOR = "-roslynos"

# Extra image configuration defaults
IMAGE_FEATURES ?= "ssh-server-openssh package-management"

# Software features shipped 
DISTRO_FEATURES:append = " wifi bluetooth keyboard"

# IP Compliance - WiFi/BT firmware
LICENSE_FLAGS_ACCEPTED = "synaptics-killswitch"

# Set default timezone
DEFAULT_TIMEZONE = "America/Los_Angeles"

# Enable systemd
INIT_MANAGER = "systemd"

DISTRO_FEATURES:append = " systemd"
VIRTUAL-RUNTIME_init_manager = "systemd"
VIRTUAL-RUNTIME_login_manager = "shadow-base"

# Prevent the SysVinit feature from being automatically enabled
DISTRO_FEATURES_BACKFILL_CONSIDERED = "sysvinit"

# Using systemd-journald without syslog daemon
VIRTUAL-RUNTIME_syslog = ""
VIRTUAL-RUNTIME_base-utils-syslog = ""

# Remove initscripts from image
VIRTUAL-RUNTIME_initscripts = ""

# Enable wic format for flashing to sdcard
IMAGE_FSTYPES = "wic wic.bmap wic.gz"

# Enable u-boot kernel image
RPI_USE_U_BOOT = "1"

# Set hostname
hostname:pn-base-files = "rainier"

# Set boot delay to not wait after loading GPU
BOOT_DELAY = "0"
BOOT_DELAY_MS = "0"
UBOOT_DELAY = "0"

# Set the verbosity of kernel messages during runtime to "loglevel=1-7"
CMDLINE_DEBUG ?= "loglevel=7"

# Enable UART console
ENABLE_UART = "1"

# Enable I2C interface
ENABLE_I2C = "1"
KERNEL_MODULE_AUTOLOAD:rpi += "i2c-dev"

# Enable SPI interface
ENABLE_SPI_BUS = "1"

# Enable USB HOST interface
ENABLE_DWC2_HOST = "1"

# MACHINE_FEATURES:remove=" wayland"
# ENABLE_UART = "1"
# RASPBERRYPI_HD_CAMERA = "1"
# VIDEO_CAMERA = "1"
# DISTRO_FEATURES:append = " pam"
# PARALLEL_MAKE = "-j 4"
# GPU_MEM_256="192"
# DISABLE_OVERSCAN = "1"
# DISABLE_SPLASH = "1"
# DISABLE_RPI_BOOT_LOGO = "1"
# MACHINE_FEATURES_append=" vc4graphics xf86-video-fbdev"
# DISTRO_FEATURES_append = " opengl x11 fbdev"
# MACHINE_FEATURES_remove=" wayland"
# VC4GRAPHICS = "1"
```

## conf/layer.conf
```bitbake
# We have a conf and classes directory, add to BBPATH
BBPATH .= ":${LAYERDIR}"

# We have recipes-* directories, add to BBFILES
BBFILES += "${LAYERDIR}/recipes-*/*/*.bb \
            ${LAYERDIR}/recipes-*/*/*.bbappend"

BBFILE_COLLECTIONS += "meta-roslynos"
BBFILE_PATTERN_meta-roslynos = "^${LAYERDIR}/"
BBFILE_PRIORITY_meta-roslynos = "6"

LAYERDEPENDS_meta-roslynos = "core"
LAYERSERIES_COMPAT_meta-roslynos = "langdale"
```

## meta-dotnet-os/conf/distro/roslynos.conf
```bitbake
require conf/distro/poky.conf

DISTRO = "roslynos"
DISTRO_NAME = "RoslynOS-Linux"
DISTRO_VERSION = "1.0"
DISTRO_CODENAME = "Dylan"
SDK_VENDOR = "-roslynossdk"
SDK_VERSION="${DISTRO_VERSION}"
TARGET_VENDOR = "-roslynos"

# Hardware features 
MACHINE_FEATURES += "wifi bluetooth"

# Extra image configuration defaults
IMAGE_FEATURES ?= "ssh-server-openssh package-management"

# Enable apt-get package managment features 
PACKAGE_FEED_URIS = "http://whisk.roslynos.com:5678"

# Remove debug teeaks from distro
# IMAGE_FEATURES:remove = "debug-tweaks"

# Software features shipped 
DISTRO_FEATURES:append = " wifi bluetooth keyboard"

# Set default timezone
DEFAULT_TIMEZONE = "America/Los_Angeles"

# Enable systemd
INIT_MANAGER = "systemd"

DISTRO_FEATURES:append = " systemd"
VIRTUAL-RUNTIME_init_manager = "systemd"

# Prevent the SysVinit feature from being automatically enabled
DISTRO_FEATURES_BACKFILL_CONSIDERED = "sysvinit"

# Using systemd-journald without syslog daemon
VIRTUAL-RUNTIME_syslog = ""
VIRTUAL-RUNTIME_base-utils-syslog = ""

# Remove initscripts from image
VIRTUAL-RUNTIME_initscripts = ""

# Enable wic format for flashing to sdcard
IMAGE_FSTYPES = "wic.gz"

# Enable u-boot kernel image
RPI_USE_U_BOOT = "1"

# Set hostname
hostname:pn-base-files = "rainier"

# Set boot delay to not wait after loading GPU
BOOT_DELAY = "0"
BOOT_DELAY_MS = "0"
UBOOT_DELAY = "0"

# Set the verbosity of kernel messages during runtime to "loglevel=1-7", "quiet", "debug"
CMDLINE_DEBUG ?= "loglevel=2"

# Enable UART console
ENABLE_UART = "1"

# Enable I2C interface
ENABLE_I2C = "1"
KERNEL_MODULE_AUTOLOAD:rpi += "i2c-dev"

# Enable SPI interface
ENABLE_SPI_BUS = "1"

# Enable USB HOST interface
ENABLE_DWC2_HOST = "1"
```

## meta-dotnet-os/conf/layer.conf
```bitbake
# We have a conf and classes directory, add to BBPATH
BBPATH .= ":${LAYERDIR}"

# We have recipes-* directories, add to BBFILES
BBFILES += "${LAYERDIR}/recipes-*/*/*.bb \
            ${LAYERDIR}/recipes-*/*/*.bbappend"

BBFILE_COLLECTIONS += "meta-dotnet-os"
BBFILE_PATTERN_meta-dotnet-os = "^${LAYERDIR}/"
BBFILE_PRIORITY_meta-dotnet-os = "6"

LAYERDEPENDS_meta-dotnet-os = "core"
LAYERSERIES_COMPAT_meta-dotnet-os = "kirkstone"
```

## meta-reterminal/conf/machine/reterminal-64.conf
```bitbake
#@TYPE: Machine
#@NAME: reTerminal powered by a Raspberry Pi Compute Module 4 (CM4)
#@DESCRIPTION: Machine configuration for the RaspberryPi 4 in 64 bits mode
MACHINEOVERRIDES = "raspberrypi4:${MACHINE}"

MACHINE_FEATURES += "pci vc4graphics"
MACHINE_EXTRA_RRECOMMENDS += "\
    linux-firmware-rpidistro-bcm43455 \
    bluez-firmware-rpidistro-bcm4345c0-hcd \
"
KERNEL_INCLUDE += "reterminal-overlay.dts"

DEFAULTTUNE = "cortexa72"

require conf/machine/include/arm/armv8a/tune-cortexa72.inc
include conf/machine/include/rpi-base.inc

RPI_KERNEL_DEVICETREE = " \
    broadcom/bcm2711-rpi-4-b.dtb \
    broadcom/bcm2711-rpi-400.dtb \
    broadcom/bcm2711-rpi-cm4.dtb \
"

RPI_KERNEL_DEVICETREE_OVERLAYS:append = " \
    overlays/i2c3.dtbo \ 
    overlays/vc4-kms-v3d-pi4.dtbo \
"

SDIMG_KERNELIMAGE ?= "kernel8.img"
SERIAL_CONSOLES ?= "115200;ttyS0"

UBOOT_MACHINE = "rpi_arm64_config"

VC4DTBO ?= "vc4-kms-v3d"

KERNEL_IMAGETYPE_UBOOT ?= "Image"
KERNEL_IMAGETYPE_DIRECT ?= "Image"
KERNEL_BOOTCMD ?= "booti"

ARMSTUB ?= "armstub8-gic.bin"

RPI_EXTRA_CONFIG += "\
# Enable VC4 RPI Graphics\n\
dtoverlay=vc4-kms-v3d-pi4\n\
# Enable I2C3\n\
dtoverlay=i2c3,pins_4_5\n\
# Enable reterminal\n\
dtoverlay=reterminal,tp_rotate=1\n\
# Load start\n\
start_x=1\n"
```
